## meta-qtui/conf/layer.conf
```bitbake
# Layer configuration for meta-qtui
BBPATH .= ":${LAYERDIR}"

# We have recipes-* directories, add to BBFILES
BBFILES += "${LAYERDIR}/recipes-*/*/*.bb \
            ${LAYERDIR}/recipes-*/*/*.bbappend"

BBFILE_COLLECTIONS += "qtui-layer"
BBFILE_PATTERN_qtui-layer = "^${LAYERDIR}/"
BBFILE_PRIORITY_qtui-layer = "6"

LAYERDEPENDS_qtui-layer = "core openembedded-layer qt6-layer"
LAYERSERIES_COMPAT_qtui-layer = "scarthgap kirkstone nanbield walnascar"
```
